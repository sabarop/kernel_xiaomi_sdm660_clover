## drivers/platform/xiaomi/Kconfig
```kconfig
# Xiaomi configuration options

config MACH_XIAOMI
	bool "Xiaomi device"
	depends on ARCH_QCOM
	help
	  Support for Xiaomi products

config MACH_XIAOMI_SDM660
	bool "Xiaomi SDM660"
	depends on ARCH_QCOM
	select MACH_XIAOMI
	help
	  Support for Xiaomi SDM660 devices

menu "Xiaomi board selection"

	config MACH_XIAOMI_CLOVER
		bool "Xiaomi clover board"
		select MACH_XIAOMI
		help
		  Support for XIaomi MI Pad 4 variant

endmenu
```

## drivers/xiaomi/Kconfig
```kconfig
config XIAOMI
	bool "Xiaomi drivers"
	default n

if XIAOMI

source "drivers/xiaomi/input/Kconfig"

config MSM_AVTIMER
	tristate "MSM_AVTIMER"

endif
```

## drivers/xiaomi/input/Kconfig
```kconfig
if INPUT

config INPUT_HALL_SENSOR
	tristate "hall sensor driver"

source "drivers/xiaomi/input/fingerprint/Kconfig"

source "drivers/xiaomi/input/touchscreen/Kconfig"

endif
```

## drivers/xiaomi/input/fingerprint/Kconfig
```kconfig
menuconfig INPUT_FINGERPRINT
	bool "Fingerprint Drivers"
	help
	  Say Y here, and a list of supported fingerprints will be displayed.
	  This option doesn't affect the kernel.

	  If unsure, say Y.

if INPUT_FINGERPRINT

source "drivers/xiaomi/input/fingerprint/fpc_clover/Kconfig"

endif
```
